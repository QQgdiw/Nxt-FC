## src/drivers/encoder_sensor/AS5600/Kconfig
```kconfig
menuconfig CONFIG_DRIVERS_ENCODER_SENSOR_AS5600
	bool "AS5600"
	default n
	---help---
		Enable support for AS5600
```

## src/drivers/encoder_sensor/Kconfig
```kconfig
menu "encoder sensor"
    menuconfig COMMON_ENCODER_SENSOR
        bool "Common encoder sensors"
        default n
        select DRIVERS_ENCODER_SENSOR_AS5600
        ---help---
            Enable default set of encoder sensor drivers
    rsource "*/Kconfig"
endmenu #barometer
```
